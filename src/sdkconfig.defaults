## src/sdkconfig.defaults
```kconfig
# FreeRTOS
CONFIG_FREERTOS_HZ=1000

# CPU
CONFIG_ESP_DEFAULT_CPU_FREQ_MHZ_240=y

# Flash (OJO: debe ser compatible con PSRAM)
CONFIG_ESPTOOLPY_FLASHMODE_QIO=y
CONFIG_ESPTOOLPY_FLASHFREQ_120M=y

# PSRAM (OCT/OPI)
CONFIG_SPIRAM_MODE_OCT=y
CONFIG_SPIRAM_SPEED_120M=y
CONFIG_SPIRAM_FETCH_INSTRUCTIONS=y
CONFIG_SPIRAM_RODATA=y

# Cache
CONFIG_ESP32S3_DATA_CACHE_LINE_64B=y

# Optimizacion
CONFIG_COMPILER_OPTIMIZATION_PERF=y

# Experimental
CONFIG_IDF_EXPERIMENTAL_FEATURES=y
```
